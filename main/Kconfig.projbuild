## main/Kconfig.projbuild
```kconfig
menu "GateMCU"

config GATEWAY_SETUP_AP_NAME
    string "Setup access point name"
    default "GateMCU-Setup"

endmenu
```

## sdkconfig.defaults
```kconfig
CONFIG_IDF_TARGET="esp8266"
CONFIG_GATEWAY_SETUP_AP_NAME="GateMCU-Setup"
CONFIG_WIREGUARD_ESP_TCPIP_ADAPTER=y
CONFIG_WIREGUARD_MAX_PEERS=1
CONFIG_WIREGUARD_MAX_SRC_IPS=2
CONFIG_WIREGUARD_x25519_IMPLEMENTATION_DEFAULT=y
CONFIG_LWIP_DHCP_RESTORE_LAST_IP=y
CONFIG_HTTPD_MAX_REQ_HDR_LEN=1024
CONFIG_LWIP_IPV6=y
CONFIG_ENABLE_MDNS=y
CONFIG_FREERTOS_GENERATE_RUN_TIME_STATS=y
CONFIG_FREERTOS_RUN_TIME_STATS_USING_ESP_TIMER=y
```
